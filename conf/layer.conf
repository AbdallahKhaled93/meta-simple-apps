## conf/layer.conf
```bitbake
# We have a conf and classes directory, add to BBPATH
BBPATH .= ":${LAYERDIR}"

# We have recipes-* directories, add to BBFILES
BBFILES += "${LAYERDIR}/recipes-*/*/*.bb \
	${LAYERDIR}/recipes-*/*/*.bbappend"

BBFILE_COLLECTIONS += "apps"
BBFILE_PATTERN_apps = "^${LAYERDIR}/"
BBFILE_PRIORITY_apps = "6"
LAYERVERSION_apps = "1"
LAYERSERIES_COMPAT_apps = "dunfell"
```
